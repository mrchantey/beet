## crates/beet_esp/sdkconfig.defaults
```kconfig
# https://docs.espressif.com/projects/esp-idf/en/stable/esp32s3/api-reference/kconfig.html
# Rust often needs a bit of an extra main task stack size compared to C (the default is 3K)
# CONFIG_ESP_MAIN_TASK_STACK_SIZE=8000

# TODO refine these
CONFIG_ESP_MAIN_TASK_STACK_SIZE=64000
CONFIG_PTHREAD_TASK_STACK_SIZE_DEFAULT=4096

# Enable SPIRAM support (esp32-s3)
CONFIG_SPIRAM=y
CONFIG_SPIRAM_BOOT_INIT=y
CONFIG_SPIRAM_TYPE_AUTO=y
CONFIG_SPIRAM_MODE_OCT=y # required for esp32-s3 N16R8
CONFIG_SPIRAM_USE_MALLOC=y
# CONFIG_SPIRAM_MEMTEST=y

# Use this to set FreeRTOS kernel tick frequency to 1000 Hz (100 Hz by default).
# This allows to use 1 ms granuality for thread sleeps (10 ms by default).
#CONFIG_FREERTOS_HZ=1000

# Workaround for https://github.com/espressif/esp-idf/issues/7631
#CONFIG_MBEDTLS_CERTIFICATE_BUNDLE=n
#CONFIG_MBEDTLS_CERTIFICATE_BUNDLE_DEFAULT_FULL=n
```
